#include "font.h"
#include "oled.h"
#include <stddef.h>
static const uint8_t Font_Upper[26][5] = {
    {0x7E, 0x09, 0x09, 0x09, 0x7E}, /* A */
    {0x7F, 0x49, 0x49, 0x49, 0x36}, /* B */
    {0x3E, 0x41, 0x41, 0x41, 0x22}, /* C */
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    {0x61, 0x51, 0x49, 0x45, 0x43}  /* Z */
};
static const uint8_t Font_Lower[26][5] = {
    {0x20, 0x54, 0x54, 0x54, 0x78}, /* a */
    {0x7F, 0x48, 0x44, 0x44, 0x38}, /* b */
    {0x38, 0x44, 0x44, 0x44, 0x20}, /* c */
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    {0x44, 0x64, 0x54, 0x4C, 0x44}  /* z */
};
static const uint8_t Font_Digit[10][5] = {
    {0x3E, 0x51, 0x49, 0x45, 0x3E}, /* 0 */
    {0x00, 0x42, 0x7F, 0x40, 0x00}, /* 1 */
    {0x42, 0x61, 0x51, 0x49, 0x46}, /* 2 */
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    {0x06, 0x49, 0x49, 0x29, 0x1E}  /* 9 */
};
static const struct {
    char character;
    uint8_t glyph[5];
} Font_Symbol[] = {
    {' ', {0x00, 0x00, 0x00, 0x00, 0x00}},
    {'-', {0x00, 0x00, 0x08, 0x00, 0x00}},
    {'.', {0x00, 0x60, 0x60, 0x00, 0x00}},
    {'!', {0x00, 0x00, 0x5F, 0x00, 0x00}}
};

static const uint8_t *Font_GetGlyph(char character)
{
    static const uint8_t unknown[5] = {
        0x02, 0x01, 0x51, 0x09, 0x06
    };

    if (character >= 'A' && character <= 'Z') {
        return Font_Upper[character - 'A'];
    }

    if (character >= 'a' && character <= 'z') {
        return Font_Lower[character - 'a'];
    }

    if (character >= '0' && character <= '9') {
        return Font_Digit[character - '0'];
    }

    for (size_t index = 0; index < sizeof(Font_Symbol) / sizeof(Font_Symbol[0]); index++) {
        if (character == Font_Symbol[index].character) {
            return Font_Symbol[index].glyph;
        }
    }

    return unknown;
}
void Font_DrawChar(OLED_HandleTypeDef *oled,
                   uint8_t x,
                   uint8_t y,
                   char character)
{
    if (oled == NULL) {
        return;
    }

    const uint8_t *glyph = Font_GetGlyph(character);

    for (uint8_t column = 0; column < 5; column++) {
        for (uint8_t row = 0; row < 7; row++) {

            if ((glyph[column] & (1 << row)) != 0) {
                uint16_t pixel_x = x + column;
                uint16_t pixel_y = y + row;

                if (pixel_x < 128 && pixel_y < 64) {
                    OLED_DrawPixel(oled->FrameBufferPtr,
                                   (uint8_t)pixel_x,
                                   (uint8_t)pixel_y);
                }
            }
        }
    }
}
void Font_DrawText(OLED_HandleTypeDef *oled,
                   uint8_t x,
                   uint8_t y,
                   const char *text)
{
    if (oled == NULL || text == NULL) {
        return;
    }

    uint16_t cursor_x = x;

    while (*text != '\0' && cursor_x < 128) {
        Font_DrawChar(oled,
                      (uint8_t)cursor_x,
                      y,
                      *text);

        cursor_x += 6;
        text++;
    }
}